## boards/espressif/esp32s2_devkitm/Kconfig.esp32s2_devkitm
```kconfig
# Copyright (c) 2024 Espressif Systems (Shanghai) Co., Ltd.
# SPDX-License-Identifier: Apache-2.0

config BOARD_ESP32S2_DEVKITM
	select SOC_ESP32S2_MINI_N4R2
```
